## arch/arm/mach-rockchip/rk3308/Kconfig
```kconfig
if ROCKCHIP_RK3308

config TARGET_EVB_RK3308
	bool "EVB_RK3308"
	select BOARD_LATE_INIT

config SYS_SOC
	default "rockchip"

config SYS_MALLOC_F_LEN
	default 0x400

config SPL_SERIAL_SUPPORT
	default y

source "board/rockchip/evb_rk3308/Kconfig"


config ROCKCHIP_RK3308_VCCIO4_1V8
	bool "Select 1.8V pad mode for VCCIO4 in U-Boot"
	depends on ROCKCHIP_RK3308
	default n
	help
	  TPL selects 3.3V for the VCCIO4 (SDIO) pad bank unconditionally, to
	  protect boards whose VCCIO4 rail is 3.3V. On a board wired for 1.8V
	  nothing corrects that until the kernel io-domain driver runs, which
	  can be after the SDIO card has been clocked to its operating rate
	  through mismatched pads.

	  Say Y only if VCCIO4 is wired to a 1.8V supply on this board. 1.8V
	  pad mode on a 3.3V rail risks damaging the SoC.

endif
```
