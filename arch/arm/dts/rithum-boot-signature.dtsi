// SPDX-License-Identifier: GPL-2.0
// Rithum boot- and logo-signing PUBLIC keys for FIT signature verification.
// PUBLIC key material only. Baked by u-boot mkimage -K (includes the RK
// hardware-crypto rsa,np/rsa,c params). Private key: meta-rithum
// rithum-boot-signing-key. Generated - do not hand-edit the key data below
// (the #ifdef wrapper is a structural addition, not part of the generated
// material).
//
// CONFIG_FIT_SIGNATURE-gated: a flavor with no FIT_SIGNATURE support has no
// use for this node - it can't verify anything with it - and shipping the
// public key anyway is what made rithum_migrate.py's own bootchain-signature
// probe have to fall back on a compiled-in error string as its signal, since
// this node's mere presence didn't distinguish the two flavors. Gating it
// makes the node's presence itself the signal: real, structural, and no
// more fragile than a Kconfig symbol. rk3308-u-boot.dtsi's own kconfig.h
// -include (scripts/Makefile.lib's dtc_cpp_flags) is what makes CONFIG_*
// macros available to a plain .dts #ifdef at all.
#ifdef CONFIG_FIT_SIGNATURE
/ {
	signature {

		key-boot {
			required = "conf";
			algo = "sha256,rsa2048";
			rsa,np = <0x00 0x00 0x00 0x00 0x00 0x00 0x00 0x00 0x00 0x00 0x00 0x00 0x00 0x00 0x00 0x00 0x00 0x00 0x00 0x00 0x00 0x00 0x00 0x00 0x00 0x00 0x00 0x00 0x00 0x00 0x00 0x00 0x00 0x00 0x00 0x00 0x00 0x00 0x00 0x00 0x00 0x00 0x00 0x00 0x00 0x00 0x00 0x00 0x00 0x00 0x00 0x00 0x00 0x00 0x00 0x00 0x00 0x00 0x00 0x12 0x5f4fef6e 0xe1d4850c 0x9e817916 0x81298a6d>;
			rsa,c = <0x2df963da 0x8c14a173 0x1229acf7 0xb3fcd52e 0x31b1208a 0xb33ee69d 0x4e3e1603 0x7c374de 0xd21a5b09 0x8ab5075 0x6a16a028 0x2bb40f09 0x46c79dd9 0x1abf94f2 0xaef0f0e3 0x5f3d3c26 0x3963d0d1 0xa59a9c92 0xb7903dc7 0xfedfcf04 0xb6ef5250 0x1a6f9edb 0x6b489a16 0xbd337570 0x363a5c6e 0xad9a575c 0xa6b3c543 0x1621201d 0xa2911aa9 0x21e5ccab 0xb85b9968 0xeb474221 0x857ca9d7 0x89f10c93 0x27a01c4e 0x31663e6c 0x37308aac 0xb77059a4 0x85d4d730 0x2a9cd0dd 0x712cfdfd 0x5105992b 0x35b1a5cb 0xdc104cc6 0x3ec14b4b 0x51e2841c 0xb82b7f15 0x2f58f93b 0xd03677a6 0xc4283b93 0x3abbd4cc 0xf41c50a7 0xc1cea513 0xab8acb46 0x14f5b5a7 0xe26625b6 0xb1de3162 0x2520c479 0xe0dec2d3 0xa3d4c5b1 0x1dd25931 0x71efc9eb 0xb9f8230b 0x78ca5890>;
			rsa,r-squared = <0x2df963d 0xa8c14a17 0x31229acf 0x7b3fcd52 0xe31b1208 0xab33ee69 0xd4e3e160 0x307c374d 0xed21a5b0 0x908ab507 0x56a16a02 0x82bb40f0 0x946c79dd 0x91abf94f 0x2aef0f0e 0x35f3d3c2 0x63963d0d 0x1a59a9c9 0x2b7903dc 0x7fedfcf0 0x4b6ef525 0x1a6f9ed 0xb6b489a1 0x6bd33757 0x363a5c6 0xead9a575 0xca6b3c54 0x31621201 0xda2911aa 0x921e5cca 0xbb85b996 0x8eb47422 0x1857ca9d 0x789f10c9 0x327a01c4 0xe31663e6 0xc37308aa 0xcb77059a 0x485d4d73 0x2a9cd0d 0xd712cfdf 0xd5105992 0xb35b1a5c 0xbdc104cc 0x63ec14b4 0xb51e2841 0xcb82b7f1 0x52f58f93 0xbd03677a 0x6c4283b9 0x33abbd4c 0xcf41c50a 0x7c1cea51 0x3ab8acb4 0x614f5b5a 0x7e26625b 0x6b1de316 0x22520c47 0x9e0dec2d 0x3a3d4c5b 0x11dd2593 0x171efc9e 0xbb9f8230 0xb78ca589>;
			rsa,modulus = <0xdef1b47e 0xc7992c8a 0x2736d8e8 0x3297ab79 0x2fa1675c 0xefd76a87 0xbe3f666d 0x2139b0a6 0x3283e6f4 0x7af23799 0x3e4543db 0xda161049 0x4173f06c 0xabb73b37 0xf949451d 0xbeb14f33 0xcd5051a6 0x7229ff8f 0x8b3758a1 0xbb8dd7e9 0xcd0803b8 0x6f87f8a2 0x146ce34b 0x7883900a 0x22632b7 0xb96c4ba2 0x5b254d0f 0x843258b9 0x9513a99b 0xaf89b24b 0x7516fd9e 0xc4e383be 0xd352067d 0xdcae6d87 0x8fef92f6 0x787e95c4 0x7cc0e230 0x638bac2b 0x7f2587f8 0x3ac2a551 0x27147d07 0x67ccbc 0x1615c8fc 0x4dc0bdfa 0xe45a19ed 0x82bb33a8 0x898a08c4 0xd405dca8 0xea837006 0x481311b9 0x7de500de 0xb8d8e357 0x23f11b43 0x84d4f6c9 0x89d4c8b1 0x82ba316e 0x618f063d 0xb0ce8d45 0x3873590a 0x4e73e708 0xac451c28 0x304dbb79 0xfd271830 0x6593785f>;
			rsa,exponent-BN = <0x00 0x00 0x00 0x00 0x00 0x00 0x00 0x00 0x00 0x00 0x00 0x00 0x00 0x00 0x00 0x00 0x00 0x00 0x00 0x00 0x00 0x00 0x00 0x00 0x00 0x00 0x00 0x00 0x00 0x00 0x00 0x00 0x00 0x00 0x00 0x00 0x00 0x00 0x00 0x00 0x00 0x00 0x00 0x00 0x00 0x00 0x00 0x00 0x00 0x00 0x00 0x00 0x00 0x00 0x00 0x00 0x00 0x00 0x00 0x00 0x00 0x00 0x00 0x10001>;
			rsa,exponent = <0x00 0x10001>;
			rsa,n0-inverse = <0x162b1c61>;
			rsa,num-bits = <0x800>;
			key-name-hint = "boot";


		};

		// The logo-signing PUBLIC key: the "logo" partition's FIT must be
		// signed by it (resource_img.c checks against this node alone). No
		// "required" property, deliberately: it signs logos only, and plays
		// no part in verifying the boot image. Private key: meta-rithum
		// rithum-logo-signing-key. Generated by mkimage -K, as key-boot is,
		// less the hash@np/hash@c OTP records it adds.
		key-logo {
			algo = "sha256,rsa2048";
			rsa,np = <0x0 0x0 0x0 0x0 0x0 0x0 0x0 0x0 0x0 0x0 0x0 0x0 0x0 0x0 0x0 0x0 0x0 0x0 0x0 0x0 0x0 0x0 0x0 0x0 0x0 0x0 0x0 0x0 0x0 0x0 0x0 0x0 0x0 0x0 0x0 0x0 0x0 0x0 0x0 0x0 0x0 0x0 0x0 0x0 0x0 0x0 0x0 0x0 0x0 0x0 0x0 0x0 0x0 0x0 0x0 0x0 0x0 0x0 0x0 0x12 0x8b6575fa 0x4f8215ed 0x46e4ea6c 0x290087c9>;
			rsa,c = <0x293b560 0xa5e20c38 0x91e04f3d 0x9136bc9c 0xc212b8f6 0xc9d33ac7 0x3f31467d 0x740be19b 0xb6986094 0xfc7731e0 0x230038a6 0x19707569 0xd0419cdf 0x2b41cb8a 0xd04d9a19 0x28bf555a 0x41036a3d 0xfc7c4a51 0xeaf9427e 0xe793513c 0x45e0ebe0 0xbc444ccb 0xcaf8e9bf 0xcbc09b6 0xb46ee6da 0xd6b12eb2 0x813de29f 0x9947af29 0xb2681967 0x1b86851 0x9c0d67df 0xfbcaaba0 0x2ce405f 0xec7ee736 0xdf67774b 0x1f292fb9 0xf22f46b3 0xa2f38815 0xbe9b5437 0xa8f4ed3e 0x8d28fce7 0x228d2a8c 0xb743505a 0x6b1ceddc 0xbc7b6f89 0x8641c86d 0x25e223ec 0x22423177 0x1eccc57c 0x9cd8a142 0x323611d3 0xfe3e3a70 0x59ca1995 0x5cec3d2c 0x914d4d77 0x9633103e 0xd64d1c53 0x44c25727 0x35254a79 0x768a6a8d 0x4a55fa68 0x8cb5e20f 0xdc0551f 0x4310d9d6>;
			rsa,r-squared = <0x52fd2099 0x8b4eceab 0xa612a5a0 0x51fde953 0x43b2ec92 0xf2fe9b80 0xca526b37 0xf3370568 0x4b5b130c 0x7cb26a15 0x12206459 0xbf889faa 0x7dbea4ce 0xb04468fc 0x1497c6fa 0xb0d455d7 0x1524170b 0xc9f2f845 0x4bed583b 0x3d417397 0x2dd8a07 0x4f5d9dc5 0x47999b83 0x9ae06778 0x4c73b6ec 0x7c27dfd9 0xb68ef45a 0x9691bddd 0xd791caaf 0x40f6e74a 0x43229f0a 0x40352199 0x8a241010 0xaac22e8b 0xf334dcb4 0x941fb7a4 0x6baab8c5 0x79982c67 0xe4e29830 0xe36be1a 0xfb7c6572 0xc7699651 0xe71808a6 0x44fc0165 0xda1d6138 0x390a6e1f 0x13b1573 0xa0df6b4f 0x74c2beff 0xaf8a644d 0x2b8aa8d2 0xc640701c 0x9fd34956 0x7885d014 0x6103d78c 0x7ec870c9 0xb8346ce1 0x9fed90c2 0x9deaa5a4 0x66a42bf7 0x9c243efc 0x5de9e879 0xbc4b84c4 0xb59d7a91>;
			rsa,modulus = <0xdcdfb8b4 0x281cfc0 0x4d3701cb 0xed1bf96e 0x942f5809 0x665914e0 0xe653922a 0xf53b68d1 0x7fd97808 0x77c7e7e8 0x2a810228 0xfa8440df 0xac9c1d57 0x4ed620b3 0xbedd2398 0x50c10159 0x2d8a566a 0x70733455 0xcdfa0ade 0x276b515d 0xfbfe9e18 0xb44397ec 0x1d1acd14 0x7037124d 0x32216a7 0x7ca2227c 0x269d9081 0xa2a35d1d 0xf6736d97 0x8249020d 0xc3af6c20 0xabebe7a9 0x6fe87571 0xca9b5596 0xb8a66355 0x5cdb717 0x76bf60f0 0xa917dfbc 0x17ed07cc 0x346928bd 0x871a39b6 0x38acb46d 0x9f0a3456 0xfb7086c0 0x2639c5ff 0x1bb8440 0x7cf7dde2 0x51f36b40 0x78fdc6a 0x64a245ed 0x6bbe148e 0xbba1768e 0xf091bf4d 0xb1e820ae 0xea7d5c8d 0x63b8aa0f 0x72299da1 0x1f03c8d5 0xc6eb82a2 0x289eb8d2 0x13fcfe3a 0x385170ec 0xc92953dc 0xae7677df>;
			rsa,exponent-BN = <0x0 0x0 0x0 0x0 0x0 0x0 0x0 0x0 0x0 0x0 0x0 0x0 0x0 0x0 0x0 0x0 0x0 0x0 0x0 0x0 0x0 0x0 0x0 0x0 0x0 0x0 0x0 0x0 0x0 0x0 0x0 0x0 0x0 0x0 0x0 0x0 0x0 0x0 0x0 0x0 0x0 0x0 0x0 0x0 0x0 0x0 0x0 0x0 0x0 0x0 0x0 0x0 0x0 0x0 0x0 0x0 0x0 0x0 0x0 0x0 0x0 0x0 0x0 0x10001>;
			rsa,exponent = <0x0 0x10001>;
			rsa,n0-inverse = <0x2cc7fbe1>;
			rsa,num-bits = <0x800>;
			key-name-hint = "logo";
		};
	};
};
#endif /* CONFIG_FIT_SIGNATURE */
